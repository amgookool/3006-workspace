## Projects/hello_world/sdkconfig.defaults
```kconfig
CONFIG_ESPTOOLPY_PORT="COM4"
# CONFIG_ESPTOOLPY_FLASHMODE_QIO is not set
CONFIG_ESPTOOLPY_FLASHMODE_DOUT=y
CONFIG_ESPTOOLPY_FLASHMODE="dout"
CONFIG_ESPTOOLPY_FLASHSIZE_1MB=y
# CONFIG_ESPTOOLPY_FLASHSIZE_2MB is not set
CONFIG_ESPTOOLPY_FLASHSIZE="1MB"
CONFIG_SPI_FLASH_SIZE=0x100000
# CONFIG_FLASHMODE_QIO is not set 
CONFIG_FLASHMODE_DOUT=y
```
